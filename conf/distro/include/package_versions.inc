## conf/distro/include/package_versions.inc
```bitbake
# Rust
RUST_BIN_VERSION ?= "1.89.0"
PREFERRED_VERSION_cargo-bin-cross-${TARGET_ARCH} ?= "${RUST_BIN_VERSION}"
PREFERRED_VERSION_cargo-bin-native ?= "${RUST_BIN_VERSION}"
PREFERRED_VERSION_rust-bin-cross-${TARGET_ARCH} ?= "${RUST_BIN_VERSION}"
PREFERRED_VERSION_rust-bin-native ?= "${RUST_BIN_VERSION}"
```
